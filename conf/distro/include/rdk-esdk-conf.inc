## conf/distro/include/rdk-esdk-conf.inc
```bitbake
# eSDK distro Changes
INHERIT_append = " uninative image-buildinfo"
include  conf/distro/include/yocto-uninative.inc
SDK_INCLUDE_NATIVESDK = "1"
require ${@bb.utils.contains_any('DISTRO_FEATURES','kirkstone scarthgap','setscene_enforce_ignore_tasks.inc','setscene_enforce_whitelist.inc',d)}
IMGCLASSES += "populate_sdk_ext"
SDK_EXT_TYPE ?= "full"
```

## conf/distro/include/rdk-versions.inc
```bitbake
#
# root location of Generic RDK components
RDK_ARTIFACTS_BASE_URL ?= "https://partners.artifactory.comcast.com/artifactory"
RDK_ARTIFACTS_URL ?= "partners.artifactory.comcast.com/artifactory"
RDK_GENERIC_ROOT_SVN ?= "svn5.teamccp.com/svn/rdk/components/generic"
RDK_GIT ?= "gerrit.teamccp.com:29418"
CMF_GIT_ROOT ?= "git://code.rdkcentral.com/r"
RBUS_RDKCENTRAL_GIT ?= "https://github.com/rdkcentral/rbus.git"
RDK_GIT_PROTOCOL ?= "ssh"
RDK_RELEASE ?= "6.1"
RDK_GENERIC_ROOT_GIT ?= "git://${RDK_GIT}/rdk/components/generic"
RDK_COMPONENTS_ROOT_GIT ?= "git://${RDK_GIT}/rdk/components"
RDKB_COMPONENTS_ROOT_GIT ?= "git://${RDK_GIT}/rdk/rdkb/components"
RDKB_CCSP_ROOT_GIT ?= "git://${RDK_GIT}/rdk/rdkb/components/opensource/ccsp"
RDKB_COMPONENTS_OS_GIT ?= "git://${RDK_GIT}/rdk/components/opensource"
RDK_GIT_BRANCH ?= "stable2"
CCSP_GIT_BRANCH ?= "stable2"
PROJECT_BRANCH ?= "default"

CMF_GIT_ROOT ?= "git://code.rdkcentral.com/r"
CMF_GIT_PROTOCOL ?= "https"
CMF_RDK_COMPONENTS_ROOT_GIT ?= "${CMF_GIT_ROOT}/rdk/components"
CMF_RDKB_COMPONENTS_ROOT_GIT ?= "${CMF_GIT_ROOT}/rdkb/components"
CMF_RDKB_CCSP_ROOT_GIT ?= "${CMF_RDKB_COMPONENTS_ROOT_GIT}/opensource/ccsp"
CMF_GIT_BRANCH ?= "rdk-next"
CMF_GIT_MASTER_BRANCH ?= "master"

CMF_GITHUB_ROOT ?= "git://github.com/rdkcentral"
CMF_GITHUB_MAIN_BRANCH ?= "main"
CMF_GITHUB_MASTER_BRANCH ?= "master"
CMF_GITHUB_STABLE2_BRANCH ?= "stable2"

SRCREV:pn-devicesettings ?= "${AUTOREV}"
SRCREV:pn-devicesettings-hal-headers ?= "${SRCREV:pn-devicesettings}"
SRCREV:pn-devicesettings-hal-noop ?= "${AUTOREV}"
SRCREV:pn-dtcpmgr-noop ?= "${AUTOREV}"
SRCREV:pn-sectionfilter-hal-noop ?= "${AUTOREV}"
SRCREV:pn-gst-plugins-rdk ?= "${AUTOREV}"
SRCREV:pn-iarmbus ?= "${AUTOREV}"
SRCREV:pn-iarmmgrs ?= "${AUTOREV}"
SRCREV:pn-iarmmgrs-hal-headers ?= "${SRCREV:pn-iarmmgrs}"
SRCREV:pn-iarmmgrs-hal-noop ?= "${AUTOREV}"
SRCREV:pn-rdk-diagnostics ?= "${AUTOREV}"
SRCREV:pn-diagnostics-snmp2json ?= "${AUTOREV}"
SRCREV:pn-rdkbrowser ?= "${AUTOREV}"
SRCREV:pn-rmfstreamer ?= "${AUTOREV}"
SRCREV:pn-rmfapp ?= "${AUTOREV}"
SRCREV:pn-rmfhalheaders ?= "${AUTOREV}"
SRCREV:pn-rmfgeneric ?= "${AUTOREV}"
SRCREV:pn-trm-common ?= "${AUTOREV}"
SRCREV:pn-wsproxy ?= "${AUTOREV}"
SRCREV:pn-qtapp ?= "${AUTOREV}"
SRCREV:pn-xupnp ?= "${AUTOREV}"
SRCREV:pn-tr69hostif ?= "${AUTOREV}"
SRCREV:pn-sysint ?= "${AUTOREV}"
SRCREV:pn-vodclient-app ?= "${AUTOREV}"
SRCREV:pn-vodclient-java ?= "${AUTOREV}"
SRCREV:pn-secapi ?= "${AUTOREV}"
SRCREV:pn-authservice ?= "${AUTOREV}"
SRCREV:pn-cachehelpers ?= "${AUTOREV}"
SRCREV:pn-hdmicec ?= "${AUTOREV}"
SRCREV:pn-hdmicecheader ?= "${AUTOREV}"
SRCREV:pn-tr69hostif-headers ?= "${AUTOREV}"
SRCREV:pn-rmfbase ?= "${AUTOREV}"
SRCREV:pn-rmfosal ?= "${AUTOREV}"
SRCREV:pn-trh ?= "${AUTOREV}"
```

## conf/distro/include/rdk_backtrace_log.inc
```bitbake
# backtrace logging is enabled
# we set this to "y" or "n" and use it as a conditional later

LOG_BACKTRACE = "${@bb.utils.contains('DISTRO_FEATURES', 'logbacktrace', 'y', 'n', d)}"

BACKTRACE_LDFLAGS ?= ""
BACKTRACE_DEPENDS ?= ""

BACKTRACE_DEPENDS:pn-iarmbus = " breakpad-wrapper"
BACKTRACE_DEPENDS:pn-iarmmgrs = " breakpad-wrapper"
BACKTRACE_DEPENDS:pn-rmfstreamer = " breakpad-wrapper"
BACKTRACE_DEPENDS:pn-rmfpodmgr = " breakpad-wrapper"
BACKTRACE_DEPENDS:pn-parodus = " breakpad-wrapper"
BACKTRACE_DEPENDS:pn-tr69hostif = " breakpad-wrapper"
BACKTRACE_DEPENDS:pn-wpeframework = " breakpad-wrapper"
BACKTRACE_DEPENDS:pn-wpa-supplicant = " breakpad-wrapper"
BACKTRACE_DEPENDS:pn-hdmicec = " breakpad-wrapper"
BACKTRACE_DEPENDS:pn-devicesettings = " breakpad-wrapper"
BACKTRACE_DEPENDS:pn-trmmgr = " breakpad-wrapper"
BACKTRACE_DEPENDS:pn-wsproxy = " breakpad-wrapper"
BACKTRACE_DEPENDS:pn-qtapp = " breakpad-wrapper"
BACKTRACE_DEPENDS:pn-ledmgr = " breakpad-wrapper"
BACKTRACE_DEPENDS:pn-audiocapturemgr = " breakpad-wrapper"
BACKTRACE_DEPENDS:pn-audioserver = " breakpad-wrapper"
BACKTRACE_DEPENDS:pn-audioserver-soc = " breakpad-wrapper"
BACKTRACE_DEPENDS:pn-runpod = " breakpad-wrapper"
BACKTRACE_DEPENDS:pn-runsnmp = " breakpad-wrapper"
BACKTRACE_DEPENDS:pn-vodclient-app = " breakpad-wrapper"
BACKTRACE_DEPENDS:pn-nlmon = " breakpad-wrapper"
BACKTRACE_DEPENDS:pn-pwr-state-monitor = " breakpad-wrapper"
BACKTRACE_DEPENDS:pn-authservice = " breakpad-wrapper"
BACKTRACE_DEPENDS:pn-aml-audio-service = " breakpad-wrapper"
BACKTRACE_DEPENDS:pn-asbluetoothrcu  = " breakpad-wrapper"
BACKTRACE_DEPENDS:pn-dnsmasq = " breakpad-wrapper"
BACKTRACE_DEPENDS:pn-rdkfwupgrader = " breakpad-wrapper"
BACKTRACE_DEPENDS:pn-cobaltlauncher = " breakpad-wrapper"
BACKTRACE_DEPENDS:pn-netflix = " breakpad-wrapper"
BACKTRACE_DEPENDS:pn-sky-nrdplugin = " breakpad-wrapper"
BACKTRACE_DEPENDS:pn-libloader-app = " breakpad-wrapper"
BACKTRACE_DEPENDS:pn-wpe-webkit = " breakpad-wrapper"
BACKTRACE_DEPENDS:pn-subttxrend-app = " breakpad-wrapper"
BACKTRACE_DEPENDS:pn-logrotate = " breakpad-wrapper"
BACKTRACE_DEPENDS:pn-AmazonPrimeVideoApp = " breakpad-wrapper"
BACKTRACE_DEPENDS:pn-amazonPrimeVideo = " breakpad-wrapper"
BACKTRACE_DEPENDS:pn-amazon-prime-library = " breakpad-wrapper"
BACKTRACE_DEPENDS:pn-skyAirplayPlugin = " breakpad-wrapper"
BACKTRACE_DEPENDS:pn-rfc = " breakpad-wrapper"

BACKTRACE_LDFLAGS:pn-iarmbus = " -Wl,--no-as-needed -lbreakpadwrapper -Wl,--as-needed "
BACKTRACE_LDFLAGS:pn-iarmmgrs = " -lbreakpadwrapper "
BACKTRACE_LDFLAGS:pn-rmfstreamer = " -lbreakpadwrapper "
BACKTRACE_LDFLAGS:pn-rmfpodmgr = " -lbreakpadwrapper "
BACKTRACE_LDFLAGS:pn-parodus = " -Wl,--no-as-needed -lbreakpadwrapper -Wl,--as-needed "
BACKTRACE_LDFLAGS:pn-tr69hostif = " -Wl,--no-as-needed -lbreakpadwrapper -Wl,--as-needed "
BACKTRACE_LDFLAGS:pn-rdkservices = " -Wl,--no-as-needed -lbreakpadwrapper -Wl,--as-needed "
BACKTRACE_LDFLAGS:pn-webkitbrowser-plugin = " -Wl,--no-as-needed -lbreakpadwrapper -Wl,--as-needed "
BACKTRACE_LDFLAGS:pn-cobalt-plugin = " -Wl,--no-as-needed -lbreakpadwrapper -Wl,--as-needed "
BACKTRACE_LDFLAGS:pn-browserlauncher = " -Wl,--no-as-needed -lbreakpadwrapper -Wl,--as-needed "
BACKTRACE_LDFLAGS:pn-wpeframework-plugin-netflix = " -Wl,--no-as-needed -lbreakpadwrapper -Wl,--as-needed "
BACKTRACE_LDFLAGS:pn-netflix = " -Wl,--no-as-needed -lbreakpadwrapper -Wl,--as-needed "
BACKTRACE_LDFLAGS:pn-sky-nrdplugin = " -Wl,--no-as-needed -lbreakpadwrapper -Wl,--as-needed "
BACKTRACE_LDFLAGS:pn-wpa-supplicant = " -Wl,--no-as-needed -lbreakpadwrapper -Wl,--as-needed "
BACKTRACE_LDFLAGS:pn-hdmicec = " -Wl,--no-as-needed -lbreakpadwrapper -Wl,--as-needed "
BACKTRACE_LDFLAGS:pn-devicesettings = " -Wl,--no-as-needed -lbreakpadwrapper -Wl,--as-needed "
BACKTRACE_LDFLAGS:pn-trmmgr = " -Wl,--no-as-needed -lbreakpadwrapper -Wl,--as-needed "
BACKTRACE_LDFLAGS:pn-wsproxy = " -Wl,--no-as-needed -lbreakpadwrapper -Wl,--as-needed "
BACKTRACE_LDFLAGS:pn-qtapp = " -Wl,--no-as-needed -lbreakpadwrapper -Wl,--as-needed "
BACKTRACE_LDFLAGS:pn-ledmgr = " -Wl,--no-as-needed -lbreakpadwrapper -Wl,--as-needed "
BACKTRACE_LDFLAGS:pn-audiocapturemgr = " -Wl,--no-as-needed -lbreakpadwrapper -Wl,--as-needed "
BACKTRACE_LDFLAGS:pn-audioserver = " -Wl,--no-as-needed -lbreakpadwrapper -Wl,--as-needed "
BACKTRACE_LDFLAGS:pn-audioserver-soc= " -Wl,--no-as-needed -lbreakpadwrapper -Wl,--as-needed "
BACKTRACE_LDFLAGS:pn-runpod = " -Wl,--no-as-needed -lbreakpadwrapper -Wl,--as-needed "
BACKTRACE_LDFLAGS:pn-runsnmp = " -Wl,--no-as-needed -lbreakpadwrapper -Wl,--as-needed "
BACKTRACE_LDFLAGS:pn-vodclient-app = " -Wl,--no-as-needed -lbreakpadwrapper -Wl,--as-needed "
BACKTRACE_LDFLAGS:pn-nlmon = " -Wl,--no-as-needed -lbreakpadwrapper -Wl,--as-needed "
BACKTRACE_LDFLAGS:pn-pwr-state-monitor = " -Wl,--no-as-needed -lbreakpadwrapper -Wl,--as-needed "
BACKTRACE_LDFLAGS:pn-authservice = " -Wl,--no-as-needed -lbreakpadwrapper -Wl,--as-needed "
BACKTRACE_LDFLAGS:pn-aml-audio-service = " -Wl,--no-as-needed -lbreakpadwrapper -Wl,--as-needed "
BACKTRACE_LDFLAGS:pn-asbluetoothrcu  = " -Wl,--no-as-needed -lbreakpadwrapper -Wl,--as-needed "
BACKTRACE_LDFLAGS:pn-dnsmasq = " -Wl,--no-as-needed -lbreakpadwrapper -Wl,--as-needed "
BACKTRACE_LDFLAGS:pn-rdkfwupgrader = " -Wl,--no-as-needed -lbreakpadwrapper -Wl,--as-needed "
BACKTRACE_LDFLAGS:pn-libloader-app = " -Wl,--no-as-needed -lbreakpadwrapper -Wl,--as-needed "
BACKTRACE_LDFLAGS:pn-wpe-webkit = " -Wl,--no-as-needed -lbreakpadwrapper -Wl,--as-needed "
BACKTRACE_LDFLAGS:pn-subttxrend-app = " -Wl,--no-as-needed -lbreakpadwrapper -Wl,--as-needed "
BACKTRACE_LDFLAGS:pn-logrotate = " -Wl,--no-as-needed -lbreakpadwrapper -Wl,--as-needed "
BACKTRACE_LDFLAGS:pn-AmazonPrimeVideoApp = " -Wl,--no-as-needed -lbreakpadwrapper -Wl,--as-needed "
BACKTRACE_LDFLAGS:pn-amazonPrimeVideo = " -Wl,--no-as-needed -lbreakpadwrapper -Wl,--as-needed "
BACKTRACE_LDFLAGS:pn-amazon-prime-library = " -Wl,--no-as-needed -lbreakpadwrapper -Wl,--as-needed "
BACKTRACE_LDFLAGS:pn-skyAirplayPlugin = " -Wl,--no-as-needed -lbreakpadwrapper -Wl,--as-needed "
BACKTRACE_LDFLAGS:pn-rfc = " -Wl,--no-as-needed -lbreakpadwrapper -Wl,--as-needed "

BACKTRACE_DEPENDS:pn-busybox = " crashlog"
BACKTRACE_DEPENDS:pn-lighttpd = " crashlog"

BACKTRACE_LDFLAGS:pn-busybox = " -Wl,--no-as-needed -lcrashlog -Wl,--as-needed"
BACKTRACE_LDFLAGS:pn-lighttpd = " -Wl,--no-as-needed -lcrashlog -Wl,--as-needed"
BACKTRACE_LDFLAGS:pn-cobaltlauncher = " -Wl,--no-as-needed -lbreakpadwrapper -Wl,--as-needed "

DEPENDS:append = " ${@LOG_BACKTRACE == "y" and BACKTRACE_DEPENDS or ""}"
LDFLAGS:append = " ${@LOG_BACKTRACE == "y" and BACKTRACE_LDFLAGS or ""}"
```
