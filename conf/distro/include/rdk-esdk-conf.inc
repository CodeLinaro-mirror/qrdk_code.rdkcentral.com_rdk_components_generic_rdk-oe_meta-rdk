## conf/distro/include/rdkb.inc
```bitbake
# Headless disable graphical splash
SPLASH = ""

DISTRO_FEATURES:append_dunfell = " virtualization"

PREFERRED_VERSION_lighttpd = "1.4.53"
PREFERRED_VERSION_libupnp = "1.6.22"
PREFERRED_VERSION_jansson = "2.7"
PREFERRED_VERSION_libnetfilter-conntrack_daisy = "1.0.2"

# Preferred gtest version/provider
PREFERRED_VERSION_googletest = "1.10.0"
PREFERRED_PROVIDER_gtest = "googletest"
PREFERRED_PROVIDER_gmock = "googletest"

DISTRO_FEATURES:append = " bluetooth"
DISTRO_FEATURES:append = " bluez5"
PREFERRED_VERSION_bluez5_dunfell ?= "5.66"
PREFERRED_VERSION_bluez5_kirkstone ?= "5.66"

PREFERRED_VERSION_php ?= "7.2.%"
PREFERRED_VERSION_php-native ?= "7.2.%"
PREFERRED_VERSION_php_dunfell ?= "7.4.%"
PREFERRED_VERSION_php-native_dunfell ?= "7.4.%"

PREFERRED_VERSION_glib-networking_kirkstone = "2.74.0"
PREFERRED_VERSION_glib-2.0_kirkstone = "2.74.6"
PREFERRED_VERSION_glib-2.0-native_kirkstone = "2.74.6"

PREFERRED_VERSION_log4c = "1.2.3"
PREFERRED_VERSION_net-snmp = "5.8"
PREFERRED_VERSION_avro-c = "1.8.1"
PREFERRED_VERSION_avro-c_kirkstone = "1.11.0"

#PREFERRED_VERSION_icu ?= "64.2"
#PREFERRED_VERSION_icu-native ?= "64.2"
PREFERRED_VERSION_icu ?= "64.%"
PREFERRED_VERSION_icu-native ?= "64.%"
PREFERRED_VERSION_icu_dunfell ?= "66.1"
PREFERRED_VERSION_icu-native_dunfell ?= "66.1"

PREFERRED_VERSION_gupnp ?= "1.2.%"
PREFERRED_VERSION_openssl_dunfell = "1.0.2o"
PREFERRED_VERSION_openssl_morty = "1.0.2o"

# Adding PREFERRED_VERSION for smcroute
PREFERRED_VERSION_smcroute ?= "2.0.0"

PREFERRED_PROVIDER_hal-cm ?= "hal-cm-generic"
PREFERRED_PROVIDER_hal-dhcpv4c ?= "hal-dhcpv4c-generic"
PREFERRED_PROVIDER_hal-ethsw ?= "hal-ethsw-generic"
PREFERRED_PROVIDER_hal-moca ?= "hal-moca-generic"
PREFERRED_PROVIDER_hal-mso_mgmt ?= "hal-mso-mgmt-generic"
PREFERRED_PROVIDER_hal-mta ?= "hal-mta-generic"
PREFERRED_PROVIDER_hal-platform ?= "hal-platform-generic"
PREFERRED_PROVIDER_hal-vlan ?= "hal-vlan-generic"
PREFERRED_PROVIDER_hal-wifi ?= "hal-wifi-generic"
PREFERRED_PROVIDER_hal-epon ?= "hal-epon-generic"
PREFERRED_PROVIDER_hal-firewall ?= "hal-firewall-generic"
PREFERRED_VERSION_jquery = "3.7.1"

PREFERRED_VERSION_libmtp = "1.1.5"
PREFERRED_VERSION_mosquitto_dunfell = "1.6.%"
PREFERRED_VERSION_mosquitto_kirkstone = "2.0.14"
PREFERRED_VERSION_gnupg_dunfell = "1.4.7"
DISTRO_FEATURES:append_dunfell = " logendpoints"

DISTRO_FEATURES:append = " tigress"
#Masking cedm multicall implementation in RDK-B
BBMASK .= " .cpgu-src|.cpgu-pbt|.cpgc-src|.cpgc-pbt"

PREFERRED_VERSION_cjson_kirkstone = "1.7.15"
PREFERRED_PROVIDER_xfhome ?= "zilker"

# Non-touchstone builds of xfhome may build iksemel that is hosted on
# rdkgerrithub.stb.r53.xcal.tv, which is not internet accessible at the time
# of this writing. Prefer iksemel PV 1.4% for touchstone, which does not depend on this host.
# This may be optionally removed once rdkgerrithub.stb.r53.xcal.tv is internet accesssible.
# meta-rdk-ext/recipes-support/iksemel at 1.5 is not compatible with xfhome.
PREFERRED_VERSION_iksemel ?= '${@oe.utils.conditional("PREFERRED_PROVIDER_xfhome", "touchstone", "1.4%", "", d)}'

VOLATILE_BINDS:append = "/usr/ccsp/ccsp_msg.cfg /ccsp_msg.cfg\n"

BBMASK .= "|.meta-rdk/recipes-core/images/rdk-oss-image.bb|meta-rdk/recipes-core/images/rdk-generic-image.bb"
BBMASK .= "|.*recipes-extended/mediaframework|.*recipes-qt"
BBMASK .= "|.meta-rdk-comcast/recipes-support/crypt-utils/*|.meta-rdk-comcast/recipes-extended/whitebox|.meta-rdk/recipes-oem/mfrlib"
BBMASK .= "|.meta-rdk-comcast/recipes-common/sec-pks-client/sec-pks-client.bb"
BBMASK .= "|.meta-rdk-comcast/recipes-common/tdk-cpc"
BBMASK .= "|.meta-rdk/recipes-extended/wifi-hal-headers|.meta-rdk-comcast/recipes-extended/acscerts"
BBMASK .= "|.meta-rdk/recipes-common/nlmonitor"
BBMASK .= "|.meta-rdk-comcast/recipes-common/cgrouputils"
BBMASK .= "|.meta-rdk-ext/recipes-extended/(?!pam)|.meta-rdk-ext/recipes-multimedia|.meta-rdk-ext/recipes-graphics|.meta-rdk-ext/recipes-utils"
BBMASK .= "|.meta-rdk-comcast/recipes-common/nvm-sqlite/nvm-sqlite.bb|.meta-rdk-comcast/recipes-common/rdkversion/rdkversion_1.0.bb"
BBMASK .= "|.meta-rdk-soc-intel-gw/meta-intelce-arm/recipes-gateway/miniupnpd/miniupnpd.bb"
BBMASK .= "|.meta-rdk/recipes-core/packagegroups/packagegroup-rdk-qt5.bb"
VOIP_MASK ?= "|.meta-rdk-broadband/recipes-ccsp/ccsp/ccsp-telcovoip-agent.bb"
BBMASK .= "${VOIP_MASK}"
WAN_MASK ?= "|.meta-rdk-broadband/recipes-ccsp/ccsp/ccsp-wanagent.bb"
BBMASK .= "${WAN_MASK}"
DSL_MASK ?= "|.meta-rdk-broadband/recipes-ccsp/ccsp/ccsp-dslagent.bb|.meta-rdk-broadband/recipes-ccsp/ccsp/ccsp-xtmagent.bb"
BBMASK .= "${DSL_MASK}"
VLAN_MASK ?= "|.meta-rdk-broadband/recipes-ccsp/ccsp/ccsp-vlanagent.bb"
BBMASK .= "${VLAN_MASK}"

FEATURE_WANMANAGER_DSL_MASK ?= "|.meta-rdk-wan/recipes-ccsp/ccsp/rdkxdslmanager.bb"
BBMASK .= "${FEATURE_WANMANAGER_DSL_MASK}"
FEATURE_WANMANAGER_WAN_MASK ?= "|.meta-rdk-wan/recipes-ccsp/ccsp/rdk-wanmanager.bb"
BBMASK .= "${FEATURE_WANMANAGER_WAN_MASK}"
FEATURE_WANMANAGER_VLAN_MASK ?= "|.meta-rdk-wan/recipes-ccsp/ccsp/rdk-vlanmanager.bb"
BBMASK .= "${FEATURE_WANMANAGER_VLAN_MASK}"
FEATURE_WANMANAGER_GPON_MASK ?= "|.meta-rdk-wan/recipes-ccsp/ccsp/rdkgponmanager.bb"
BBMASK .= "${FEATURE_WANMANAGER_GPON_MASK}"
FEATURE_WANMANAGER_PPP_MASK ?= "|.meta-rdk-wan/recipes-ccsp/ccsp/rdk-ppp-manager.bb"
BBMASK .= "${FEATURE_WANMANAGER_PPP_MASK}"
FEATURE_WANMANAGER_FWUPGRADE_MASK ?= "|.meta-rdk-broadband/recipes-ccsp/ccsp/rdk-fwupgrade-manager.bb"
BBMASK .= "${FEATURE_WANMANAGER_FWUPGRADE_MASK}"
FEATURE_WANMANAGER_VOICEMGR_MASK ?= "|.meta-rdk-broadband/recipes-ccsp/ccsp/rdktelcovoicemanager.bb"
BBMASK .= "${FEATURE_WANMANAGER_VOICEMGR_MASK}"
FEATURE_WANMANAGER_IPOE_MASK ?= "|.meta-rdk-wan/recipes-support/ipoe-health-check/ipoe-health-check.bb"
BBMASK .= "${FEATURE_WANMANAGER_IPOE_MASK}"
FEATURE_WANMANAGER_JSONHAL_MASK ?= "|.meta-rdk-broadband/recipes-support/json-hal/json-hal-lib.bb"
BBMASK .= "${FEATURE_WANMANAGER_JSONHAL_MASK}"
FEATURE_RDKB_LED_MANAGER ?= "|.meta-rdk-broadband/recipes-ccsp/ccsp/rdk-ledmanager.bb"
BBMASK .= "${FEATURE_RDKB_LED_MANAGER}"
FEATURE_CELLULAR_MANAGER_MASK ?= "|.meta-rdk-broadband/recipes-ccsp/ccsp/rdk-cellularmanager.bb"
BBMASK .= "${FEATURE_CELLULAR_MANAGER_MASK}"
FEATURE_RDKB_INTER_DEVICE_MANAGER ?= "|.meta-rdk-broadband/recipes-ccsp/ccsp/rdk-interdevicemanager.bb"
BBMASK .= "${FEATURE_RDKB_INTER_DEVICE_MANAGER}"
FEATURE_RDKB_LAN_MANAGER ?= "|.meta-rdk-broadband/recipes-ccsp/ccsp/lanmanager.bb"
BBMASK .= "${FEATURE_RDKB_LAN_MANAGER}"
FEATURE_RDKB_PLATFORM_MANAGER ?= "|.meta-rdk-broadband/recipes-ccsp/ccsp/platformmanager.bb"
BBMASK .= "${FEATURE_RDKB_PLATFORM_MANAGER}"

HUBLINUX_MASK ?= "|.meta-rdk-soc-broadcom-broadband/meta-brcm-broadband/recipes-kernel/linux/bcalinux_4.19.bb"
BBMASK .= "${HUBLINUX_MASK}"

# add rdkversion_1.0.bb is not supported for broadband devices.
BBMASK .= "|./meta-rdk/recipes-common/rdkversion/"

DISTRO_FEATURES:append = " rdm-versioning"
DISTRO_FEATURES:append = " telemetry2_0"
DISTRO_FEATURES:append = " snmppa"

# add new breakpad framework for RDKB
DISTRO_FEATURES:append  = " logbacktrace"
require conf/distro/include/rdkb_backtrace_log.inc

DISTRO_FEATURES:append = " heaptrack"
DISTRO_FEATURES:remove_morty = " heaptrack"
PREFERRED_VERSION_heaptrack_kirkstone = "1.2.%"

DISTRO_FEATURES:remove = "alsa"
DISTRO_FEATURES:remove = "ext2"
DISTRO_FEATURES:remove = "zeroconf"
DISTRO_FEATURES:remove = "nfs"
DISTRO_FEATURES:append = " safec"
#DISTRO_FEATURES:append = " webui_php"
DISTRO_FEATURES:append = " webui_jst"
#DISTRO_FEATURES:append = " gtestapp"
DISTRO_FEATURES:append = " redrecovery"
# For Apparmor
DISTRO_FEATURES:append = " apparmor"
# Add apparmor_earlypolicy.bbclass
DISTRO_FEATURES:append = " apparmor_segmented_global"

OPTIMIZE_DEFAULT = "-Os"

# Disabling MoCA support
#DISTRO_FEATURES:append = " no_moca_support"

#DISTRO_FEATURES:append = " enable_xmeminsight"

#Masking the below recipes because in kirkstone build recipes pulling older version due to layer priority
BBMASK .= "${@bb.utils.contains('DISTRO_FEATURES', 'kirkstone', '|.meta-rdk-ext/recipes-devtools/jsonrpc/jsonrpc_0.7.0.bb', '', d)}"
BBMASK .= "${@bb.utils.contains('DISTRO_FEATURES', 'kirkstone', '|.meta-rdk-ext/recipes-devtools/jsoncpp/jsoncpp_1.8.4.bb', '', d)}"
BBMASK .= "${@bb.utils.contains('DISTRO_FEATURES', 'kirkstone', '|.meta-rdk-ext/recipes-devtools/jsoncpp/jsoncpp_0.6.0-rc2.bb', '', d)}"

#Dev Key should be used for SSH authentication for Devices marked as Test
DISTRO_FEATURES:append = " dynamic_keying "

#Yocto-6.0 Wrynose Changes
#PREFERRED_VERSION_bluez5:wrynose = "5.86"
PREFERRED_VERSION_bluez5:wrynose = "5.72"
PREFERRED_VERSION_openssl:wrynose = "3.5.6"
PREFERRED_VERSION_systemd:wrynose = "259.5"
PREFERRED_VERSION_dnsmasq:wrynose = "2.93"
PREFERRED_VERSION_jsoncpp:wrynose = "1.9.7"
PREFERRED_VERSION_heaptrack:wrynose = "1.5.%"
PREFERRED_VERSION_bind:wrynose = "9.20.%"
PREFERRED_VERSION_gnutls:wrynose = "3.8.12"
PREFERRED_VERSION_nettle:wrynose = "3.10.2"
PREFERRED_VERSION_python3-jinja2-native:wrynose = "3.1.6"
PREFERRED_VERSION_tar:wrynose = "1.35"
PREFERRED_VERSION_glib-2.0:wrynose = "2.88.0"
PREFERRED_VERSION_glib-networking:wrynose = "2.80.1"
PREFERRED_VERSION_glib-2.0-native:wrynose = "2.88.0"
PREFERRED_VERSION_lua:wrynose = "5.5.0"
PREFERRED_VERSION_lua-native:wrynose = "5.5.0"
PREFERRED_VERSION_bc:wrynose = "1.06"
PREFERRED_VERSION_bc-native:wrynose = "1.06"
PREFERRED_VERSION_grep:wrynose = "3.12"
PREFERRED_VERSION_quagga:wrynose = "1.2.4"
PREFERRED_VERSION_coreutils:wrynose = "6.9"
PREFERRED_VERSION_gawk:wrynose = "5.4.0"
PREFERRED_VERSION_lighttpd:wrynose = "1.4.82"
PREFERRED_VERSION_msgpack-c:wrynose = "6.1.0"
PREFERRED_VERSION_libupnp:wrynose = "1.14.18"
PREFERRED_VERSION_gmp:wrynose = "6.3.0"
PREFERRED_VERSION_python3-setuptools:wrynose = "82.0.1"
PREFERRED_VERSION_python3-setuptools-native:wrynose = "82.0.1"
PREFERRED_VERSION_json-c:wrynose = "0.18"
PREFERRED_VERSION_gmp:wrynose = "6.3.0"
PREFERRED_VERSION_gnutls:wrynose = "3.8.12"
PREFERRED_VERSION_net-snmp:wrynose = "5.9.5.2"
PREFERRED_VERSION_elfutils:wrynose = "0.194"
PREFERRED_VERSION_iproute2:wrynose = "6.19.0"
PREFERRED_VERSION_libpcre:wrynose = "8.45"
PREFERRED_VERSION_smcroute:wrynose = "2.5.7"
PREFERRED_VERSION_iw:wrynose = "6.17"
PREFERRED_VERSION_bc:wrynose = "1.06"
PREFERRED_VERSION_bc-native:wrynose = "1.06"
PREFERRED_VERSION_libarchive:wrynose = "3.8.7"
PREFERRED_VERSION_rust:wrynose = "1.94.1"
PREFERRED_VERSION_rust-native:wrynose = "1.94.1"
PREFERRED_VERSION_cargo:wrynose = "1.94.1"
PREFERRED_VERSION_cargo-native:wrynose = "1.94.1"
PREFERRED_VERSION_libseccomp:wrynose = "2.6.0"

BBMASK .= "|meta-rdk-oss-reference/recipes-devtools/elfutils/elfutils_0.148.bb"
BBMASK .= "|meta-rdk-oss-reference/recipes-devtools/elfutils/elfutils_0.148.bbappend"

BBMASK .= "|meta-rdk-oss-reference/recipes-protocols/net-snmp/net-snmp_5.9.%.bbappend"
BBMASK .= "|meta-rdk-oss-reference/recipes-connectivity/openssl*"
BBMASK .= "|meta-oss-common-config/recipes-connectivity/bluez5/bluez5_5.48.bb"
BBMASK .= "|meta-rdk-oss-reference/recipes-connectivity/bluez5/bluez5_5.66.bb"
BBMASK .= "|meta-rdk-oss-reference/recipes-core/systemd/systemd_230.bb"
BBMASK .= "|meta-rdk-broadband/recipes-support/dnsmasq/dnsmasq_2.83.bb"
BBMASK .= "|meta-rdk-oss-reference/recipes-devtools/jsoncpp/jsoncpp_1.8.4.bb"
BBMASK .= "|meta-rdk-oss-reference/recipes-gplv2/gmp/gmp_4.2.1.bb"
BBMASK .= "|meta-rdk-oss-reference/recipes-support/mbedtls/mbedtls_2.16.3.bb"
BBMASK .= "|meta-rdk-oss-reference/recipes-protocols/net-snmp-5.8/net-snmp_5.8.bb"

BBMASK .= "|meta-cmf-filogic/recipes-connectivity/iproute2/iproute2_6.7.0.bb"
BBMASK .= "|meta-cmf/recipes-connectivity/bluez/bluez5_5.48.bbappend"
BBMASK .= "|.meta-filogic/recipes-kernel/linux/linux-mediatek_5.4.bb"
BBMASK .= "|.meta-cmf-mesh/recipes-thirdparty/python3-jinja2-native/python3-jinja2-native_2.11.1.bb"
BBMASK .= "|.meta-rdk-oss-reference/classes/breakpad-wrapper.bbclass"
BBMASK .= "|.meta-rdk-oss-reference/recipes-rdk/breakpad_wrapper/breakpad-wrapper.bb"
BBMASK .= "|.meta-rdk-oss-reference/recipes-containers/crun/crun_1.7.2.bb"
BBMASK .= "|.meta-rdk-oss-reference/recipes-connectivity/openssl*"
BBMASK .= "|.meta-oss-common-config/recipes-connectivity/bluez5/bluez5_5.48.bb"
BBMASK .= "|.meta-rdk-oss-reference/recipes-core/systemd/systemd_230.bb"
BBMASK .= "|.meta-rdk-oss-reference/recipes-devtools/opkg/opkg_%.bbappend"
BBMASK .= "|.meta-rdk-oss-reference/recipes-gplv2/gnutls/gnutls_3.3.30.bb"
BBMASK .= "|.meta-rdk-oss-reference/recipes-gplv2/nettle/nettle_2.7.1.bb"
BBMASK .= "|.meta-rdk/recipes-extended/jquery/jquery_git.bb"
BBMASK .= "|.meta-rdk-oss-reference/recipes-devtools/heaptrack/heaptrack_1.5.0.bb"
BBMASK .= "|.meta-rdk-oss-reference/recipes-common/lighttpd/lighttpd_1.4.53.bb"
BBMASK .= "|.meta-rdk-oss-reference/recipes-extended/(?!pam|tar)|.meta-rdk-oss-reference/recipes-multimedia|.meta-rdk-oss-reference/recipes-graphics/"
BBMASK .= "|.meta-rdk-oss-reference/recipes-devtools/breakpad/breakpad_git.bb"
BBMASK .= "|.meta-filogic/recipes-wifi/json-c/json-c_0.15.bb"
BBMASK .= "|.meta-rdk-oss-reference/recipes-support/cjson/cjson_1.7%.bbappend"
BBMASK .= "|.meta-rdk-oss-reference/recipes-gplv2/gettext/gettext_0.16.1.bb"
BBMASK .= "|.meta-rdk-oss-reference/recipes-common/log4c/log4c_1.2.3.bb"
BBMASK .= "|.meta-rdk-oss-reference/recipes-common/libupnp/libupnp_1.6.22.bb"

# Wrynose build - missing bb file
# ToDo : Remove later
BBMASK .= "|meta-rdk-broadband/recipes-ccsp/util/libupnp_1.6.%.bbappend"
BBMASK .= "|meta-cmf-mesh/recipes-opensync/opensync/opensync_git.bbappend"
BBMASK .= "|meta-lts-mixins/recipes-example/rust-hello-world/rust-hello-world_%.bbappend"
BBMASK .= "|meta-rdk-oss-reference/recipes-support/dnsmasq/dnsmasq_2.83.bb"
BBMASK .= "|meta-rdk-oss-reference/recipes-support/dnsmasq/dnsmasq_2.83.bbappend"
BBMASK .= "|meta-cmf-broadband/recipes-support/dnsmasq/dnsmasq_2.81.bbappend"
BBMASK .= "|meta-rdk-oss-reference/recipes-devtools/abseil-cpp/abseil-cpp_git.bbappend"
BBMASK .= "|meta-rdk-oss-reference/recipes-graphics/cairo/cairo_1.16.0.bbappend"
BBMASK .= "|meta-rdk-oss-reference/recipes-graphics/freetype/freetype_2.11.1.bbappend"
BBMASK .= "|meta-rdk-oss-reference/recipes-graphics/harfbuzz/harfbuzz_4.0.1.bbappend"
BBMASK .= "|meta-rdk-oss-reference/recipes-graphics/spir/spirv-tools_1.3.204.1.bbappend"
BBMASK .= "|meta-rdk-oss-reference/recipes-graphics/vulkan/vulkan-tools_1.3.204.1.bbappend"
BBMASK .= "|meta-rdk-oss-reference/recipes-kernel/linux-libc-headers/linux-libc-headers_5.16.bbappend"
BBMASK .= "|meta-rdk-oss-reference/recipes-multimedia/alsa/alsa-lib_1.2.6%.bbappend"
BBMASK .= "|meta-rdk-oss-reference/recipes-multimedia/libomxil/libomxil_%.bbappend"
BBMASK .= "|meta-rdk-oss-reference/recipes-multimedia/libomxil/libomxil_0.9.%.bbappend"
BBMASK .= "|meta-rdk-oss-reference/recipes-multimedia/libpng/libpng_1.6.3%.bbappend"
BBMASK .= "|meta-rdk-oss-reference/recipes-multimedia/vlc/vlc_3.0.17-1.bbappend"
BBMASK .= "|meta-rdk-broadband-apps/recipes-lcm/timingila-cthulhu/timingila-cthulhu_v2.2.0.bbappend"
BBMASK .= "|meta-cmf-broadband/recipes-connectivity/opensync/opensync_2.0.5.bbappend"
BBMASK .= "|meta-cmf-broadband/recipes-connectivity/opensync/opensync_3.2.7.bbappend"
BBMASK .= "|meta-cmf-broadband/recipes-connectivity/opensync/opensync_git.bbappend"
BBMASK .= "|meta-cmf-broadband/recipes-support/dnsmasq/dnsmasq_2.81.bbappend"
BBMASK .= "|meta-rdk/recipes-core/eglibc/eglibc-locale_%.bbappend"
BBMASK .= "|meta-rdk/recipes-extended/sysint/sysint-min_git.bbappend"
BBMASK .= "|meta-cmf/recipes-avs/openblas/openblas_0.2.20.bbappend"
BBMASK .= "|meta-cmf/recipes-bsp/u-boot/u-boot-mkimage_%.%.bbappend"
BBMASK .= "|meta-cmf/recipes-common/rtremote/rtremote_git.bbappend"
BBMASK .= "|meta-cmf/recipes-connectivity/bluealsa/bluealsa_0.1.bbappend"
BBMASK .= "|meta-cmf/recipes-connectivity/bluetooth/bluetooth-core_git.bbappend"
BBMASK .= "|meta-cmf/recipes-connectivity/bluetooth/bluetooth-leappmgr_git.bbappend"
BBMASK .= "|meta-cmf/recipes-connectivity/bluetooth/bluetooth-mgr_git.bbappend"
BBMASK .= "|meta-cmf/recipes-core/busybox/busybox_1.31.1.bbappend"
BBMASK .= "|meta-cmf/recipes-core/images/rdk-generic-hybrid-dtv-image.bbappend"
BBMASK .= "|meta-cmf/recipes-core/images/rdk-generic-hybrid-wpe-lxc-image.bbappend"
BBMASK .= "|meta-cmf/recipes-core/packagegroups/packagegroup-rdk-media-common.bbappend"
BBMASK .= "|meta-cmf/recipes-extended/asbluetoothrcu/asbluetoothrcu.bbappend"
BBMASK .= "|meta-cmf/recipes-graphics/directfb/linux-fusion_9.0.3.bbappend"
BBMASK .= "|meta-cmf/recipes-graphics/libinput/libinput_git.bbappend"
BBMASK .= "|meta-cmf/recipes-kernel/linux/android-raspberrypi_%.bbappend"
BBMASK .= "|meta-cmf/recipes-kernel/linux/linux-meson_%.bbappend"
BBMASK .= "|meta-cmf/recipes-kernel/linux/linux-raspberrypi-rt_%.bbappend"
BBMASK .= "|meta-cmf/recipes-kernel/linux/linux-raspberrypi_%.bbappend"
BBMASK .= "|meta-cmf/recipes-kernel/linux/linux-rtk_%.bbappend"
BBMASK .= "|meta-cmf/recipes-kernel/linux/stblinux_%.bbappend"
BBMASK .= "|meta-cmf/recipes-multimedia/gst-external-plugin/gst-external-plugin.bbappend"
BBMASK .= "|meta-cmf/recipes-multimedia/gstreamer/gstreamer1.0-plugins-ugly_git.bbappend"
BBMASK .= "|meta-cmf/recipes-support/ca-certificates/ca-certificates_20160104.bbappend"
BBMASK .= "|meta-cmf/recipes-support/ca-certificates/ca-certificates_20210119.bbappend"
BBMASK .= "|meta-cmf/recipes-support/eventlog/eventlog_0.2.13.bbappend"
BBMASK .= "|meta-cmf/recipes-support/libcroco/libcroco_0.6.%.bbappend"
BBMASK .= "|meta-cmf/recipes-support/libproxy/libproxy_0.4.15.bbappend"
BBMASK .= "|meta-cmf/recipes-support/libtomcrypt/libtomcrypt_1.17.bbappend"
BBMASK .= "|meta-rdk-oss-reference/recipes-devtools/python/python_2.7.%.bbappend"

# Wrynose PREFERRED_VERSION is set
BBMASK .= "|meta-cmf/recipes-support/icu/icu_64.1.bbappend"
BBMASK .= "|meta-lts-mixins/recipes-devtools/python/python3-setuptools-scm_6.4.2.bbappend"
BBMASK .="|meta-lts-mixins/recipes-devtools/python/python3-setuptools_69.1.1.bb"
BBMASK .= "|meta-rdk-oss-reference/recipes-connectivity/gupnp/gssdp_1.4.0.1.bbappend"
BBMASK .= "|meta-rdk-oss-reference/recipes-connectivity/libwebsockets/libwebsockets_4.2.%.bbappend"
BBMASK .= "|meta-rdk-oss-reference/recipes-core/busybox/busybox_1.35%.bbappend"
BBMASK .= "|meta-rdk-oss-reference/recipes-core/dropbear/dropbear_2020.%.bbappend"
BBMASK .= "|meta-rdk-oss-reference/recipes-core/glib-2.0/glib-2.0_2.72.%.bbappend"
BBMASK .= "|meta-rdk-oss-reference/recipes-core/glib-networking/glib-networking_2.72.%.bbappend"
BBMASK .= "|meta-rdk-oss-reference/recipes-core/glibc/glibc_2.3%.bbappend"
BBMASK .= "|meta-rdk-oss-reference/recipes-core/glibc/glibc_2.35.bbappend"
BBMASK .= "|meta-rdk-oss-reference/recipes-core/libxml2/libxml2_2.9.14.bbappend"
BBMASK .= "|meta-rdk-oss-reference/recipes-core/systemd/systemd_250.%.bbappend"
BBMASK .= "|meta-rdk-oss-reference/recipes-devtools/python/python3_3.10.15.bbappend"
BBMASK .= "|meta-rdk-oss-reference/recipes-extended/pam/libpam_1.5.2.bbappend"
BBMASK .= "|meta-rdk-oss-reference/recipes-extended/redis/redis_7.0.13%.bbappend"
BBMASK .= "|meta-rdk-oss-reference/recipes-extended/xz/xz_5.2.6.bbappend"
BBMASK .= "|meta-rdk-oss-reference/recipes-support/c-ares/c-ares_1.18.1.bbappend"
BBMASK .= "|meta-rdk-oss-reference/recipes-support/curl/curl_7.%.bbappend"
BBMASK .= "|meta-rdk-oss-reference/recipes-support/curl/curl_7.82%.bbappend"
BBMASK .= "|meta-rdk-oss-reference/recipes-support/dlt-daemon/dlt-daemon_2.18.%.bbappend"
BBMASK .= "|meta-rdk-oss-reference/recipes-support/dnsmasq/dnsmasq_2.90.bbappend"
BBMASK .= "|meta-rdk-oss-reference/recipes-support/gmp/gmp_6.2.1.bbappend"
BBMASK .= "|meta-rdk-oss-reference/recipes-support/gmp/gmp_4.2.1.bbappend"
BBMASK .= "|meta-rdk-oss-reference/recipes-support/icu/icu_70.1.bbappend"
BBMASK .= "|meta-rdk-oss-reference/recipes-support/libgcrypt/libgcrypt_1.9%.bbappend"
BBMASK .= "|meta-rdk-oss-reference/recipes-support/libsoup/libsoup-2.4_2.74.2.bbappend"
BBMASK .= "|meta-rdk-oss-reference/recipes-support/libtinyxml2/libtinyxml2_9.0.0.bbappend"
BBMASK .= "|meta-rdk-oss-reference/recipes-support/lvm2/lvm2_2.03.11.bbappend"
BBMASK .= "|meta-rdk-oss-reference/recipes-support/nanomsg/nanomsg_1.1.5.bbappend"
BBMASK .= "|meta-rdk-oss-reference/recipes-support/neon/neon_0.30.2.bbappend"
BBMASK .= "|meta-rdk-oss-reference/recipes-support/wireshark/wireshark_3.4.12.bbappend"
BBMASK .= "|meta-rdk-broadband/recipes-extended/kbd/kbd_2.0.3.bbappend"
BBMASK .= "|meta-rdk-broadband/recipes-support/libsoup/libsoup-2.4_2.58.1.bbappend"
BBMASK .= "|meta-rdk-broadband/recipes-support/libsoup/libsoup-2.4_2.68.4.bbappend"
BBMASK .= "|meta-rdk-broadband/recipes-support/libsoup/libsoup-2.4_2.74.2.bbappend"
BBMASK .= "|meta-cmf-broadband/recipes-ccsp/ccsp/modemmanager_1.20.3.bbappend"
BBMASK .= "|meta-rdk/recipes-devtools/jq/jq_1.6.bbappend"
BBMASK .= "|meta-rdk/recipes-support/neon/neon_0.30.2.bbappend"
BBMASK .= "|meta-rdk/recipes-support/nettle/nettle_3.7.%.bbappend"
BBMASK .= "|meta-cmf/recipes-common/heaptrack/heaptrack_1.0.0.bbappend"
BBMASK .= "|meta-cmf/recipes-connectivity/bind/bind_9.11.%.bbappend"
BBMASK .= "|meta-cmf/recipes-connectivity/bluez/bluez5_5.48.bbappend"
BBMASK .= "|meta-cmf/recipes-connectivity/libmtp/libmtp_1.1.5.bbappend"
BBMASK .= "|meta-cmf/recipes-connectivity/libwebsockets/libwebsockets_2.0.2.bbappend"
BBMASK .= "|meta-cmf/recipes-connectivity/mosquitto/mosquitto_2.0.14.bbappend"
BBMASK .= "|meta-cmf/recipes-connectivity/openssl/openssl_1.1.0g.bbappend"
BBMASK .= "|meta-cmf/recipes-connectivity/openssl/openssl_1.1.1%.bbappend"
BBMASK .= "|meta-cmf/recipes-connectivity/wpa-supplicant/wpa-supplicant_2.7.bbappend"
BBMASK .= "|meta-cmf/recipes-connectivity/wpa-supplicant/wpa-supplicant_2.9.bbappend"
BBMASK .= "|meta-cmf/recipes-core/glib-2.0/glib-2.0_2.62%.bbappend"
BBMASK .= "|meta-cmf/recipes-core/glibc/glibc_2.31.bbappend"
BBMASK .= "|meta-cmf/recipes-devtools/jsoncpp/jsoncpp_0.6.0-rc2.bbappend"
BBMASK .= "|meta-cmf/recipes-devtools/jsoncpp/jsoncpp_1.8.4.bbappend"
BBMASK .= "|meta-cmf/recipes-devtools/protobuf/protobuf_3.11.4.bbappend"
BBMASK .= "|meta-cmf/recipes-devtools/rsync/rsync_2.6.9.bbappend"
BBMASK .= "|meta-cmf/recipes-extended/breakpad/breakpad_git.bbappend"
BBMASK .= "|meta-cmf/recipes-protocols/net-snmp/net-snmp_5.9.1.bbappend"
BBMASK .= "|meta-rdk-oss-reference/recipes-protocols/net-snmp/net-snmp_5.8.bbappend"
BBMASK .= "|meta-cmf/recipes-support/nanomsg/nanomsg_1.0.bbappend"
BBMASK .= "|meta-cmf/recipes-support/tcpdump/tcpdump_4.9.3.bbappend"
BBMASK .= "|meta-rdk-oss-reference/recipes-support/gnutls/gnutls_3.3.30.bbappend"
BBMASK .= "|meta-rdk-broadband/recipes-rdkb/quagga/quagga_1.0.20160315.bbappend"
BBMASK .= "|meta-rdk-broadband/recipes-rdkb/quagga/quagga_1.2.1.bbappend"
BBMASK .= "|meta-cmf-broadband/recipes-ccsp/ccsp/ccsp-webui-csrf.bbappend"
BBMASK .= "|meta-cmf-broadband/recipes-devtools/breakpad/breakpad_git.bbappend"
BBMASK .= "|meta-cmf/recipes-support/cjwt/cjwt_1.0.bbappend"
BBMASK .= "|.meta-rdk-oss-reference/recipes-core/zlib/zlib_1.2.11.bb"
BBMASK .= "|.meta-rdk-oss-reference/recipes-support/msgpack/msgpack-c_2.1.1.bb"
BBMASK .= "|.meta-rdk-oss-reference/recipes-gplv2/grep/grep_2.5.1a.bb"
BBMASK .= "|meta-cmf-bananapi/meta-rdk-mtk-bpir4/recipes-wifi/json-c/json-c_0.15.bbappend"
BBMASK .= "|meta-lts-mixins/recipes-devtools/rust/"
BBMASK .= "|meta-lts-mixins/recipes-devtools/python/"
BBMASK .= "|meta-rdk-oss-reference/recipes-devtools/rust-1.72.0/"
BBMASK .= "|meta-rdk-oss-reference/recipes-devtools/cargo-1.72.0/"
BBMASK .= "|meta-rdk-oss-reference/recipes-core/glib-2.0_2.74.6/"
BBMASK .= "|meta-rdk-oss-reference/recipes-core/glib-2.0/glib-2.0_2.7%.bbappend"
```
